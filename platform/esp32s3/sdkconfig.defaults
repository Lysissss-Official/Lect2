## platform/esp32s3/sdkconfig.defaults
```kconfig
CONFIG_FREERTOS_HZ=1000

CONFIG_COMPILER_CXX_EXCEPTIONS=y
CONFIG_COMPILER_CXX_RTTI=y

CONFIG_ESP_MAIN_TASK_STACK_SIZE=8192
CONFIG_ESP_SYSTEM_EVENT_TASK_STACK_SIZE=4096

CONFIG_LOG_DEFAULT_LEVEL_INFO=y
```
